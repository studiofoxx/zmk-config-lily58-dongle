## boards/shields/lily58/Kconfig.shield
```kconfig
# Copyright (c) 2020 Pete Johanson
# SPDX-License-Identifier: MIT

config SHIELD_LILY58d_LEFT
    def_bool $(shields_list_contains,lily58d_left)

config SHIELD_LILY58d_RIGHT
    def_bool $(shields_list_contains,lily58d_right)
	
config SHIELD_LILY58d_DONGLE
    def_bool $(shields_list_contains,lily58d_dongle)
```
